## drivers/Kconfig
```kconfig
rsource "input/Kconfig"
rsource "behaviors/Kconfig"
rsource "input_processors/Kconfig"
rsource "crash_guard/Kconfig"
```

## drivers/crash_guard/Kconfig
```kconfig
config ZMK_CRASH_GUARD
    bool "Record fatal errors and hangs, then reboot automatically"
    select THREAD_NAME
    select REBOOT
    select HWINFO
    help
      Replace the default "halt forever" fatal error handler with one that
      records the reason, faulting thread and PC/LR in RAM that survives a
      soft reset, then reboots. The last record and a crash counter are saved
      to settings and can be printed with zmk_crash_guard_format().

if ZMK_CRASH_GUARD

config ZMK_CRASH_GUARD_WATCHDOG
    bool "Detect hung work queues with the task watchdog"
    default y
    select TASK_WDT
    help
      Feed a task watchdog channel from each watched work queue (the system
      work queue plus any queue registered with zmk_crash_guard_watch_work_q()).
      A queue that does not run within the timeout is recorded as a hang and
      the system reboots.

if ZMK_CRASH_GUARD_WATCHDOG

config ZMK_CRASH_GUARD_HW_WATCHDOG
    bool "Back the task watchdog with the hardware watchdog"
    default y
    select WATCHDOG
    help
      Resets the chip even when interrupts stay blocked (the task watchdog
      itself relies on the kernel timer interrupt). Such a reset is reported
      from the reset cause, without thread or PC details.

config ZMK_CRASH_GUARD_WATCHDOG_TIMEOUT_MS
    int "Hang timeout for watched work queues (ms)"
    default 10000
    range 1000 30000

config ZMK_CRASH_GUARD_WATCHDOG_FEED_MS
    int "Feed interval for watched work queues (ms)"
    default 5000

config ZMK_CRASH_GUARD_MAX_WATCHES
    int "Maximum number of watched work queues"
    default 4

# All channels share one timeout, so the background hardware watchdog feed only
# has to run that often (the 100 ms default would wake the CPU 10 times/s).
config TASK_WDT_MIN_TIMEOUT
    default ZMK_CRASH_GUARD_WATCHDOG_TIMEOUT_MS

config TASK_WDT_HW_FALLBACK
    default n if !ZMK_CRASH_GUARD_HW_WATCHDOG

# Leave the software callback time to record the hang before the hardware resets.
config TASK_WDT_HW_FALLBACK_DELAY
    default 1000

endif # ZMK_CRASH_GUARD_WATCHDOG

endif # ZMK_CRASH_GUARD
```

## drivers/input_processors/Kconfig
```kconfig
config ZMK_INPUT_PROCESSOR_SCROLL_SPEED
    bool "Per-host runtime scroll speed input processor"
    default y
    depends on DT_HAS_ZMK_INPUT_PROCESSOR_SCROLL_SPEED_ENABLED
    depends on ZMK_POINTING
    help
      Scales scroll events by a percentage kept separately for USB and for
      each BLE profile, adjustable at runtime and persisted to flash.
```

## dts/bindings/input/azoteq,iqs5xx-common.yaml
```yaml
properties:
  rdy-gpios:
    type: phandle-array
    description: "Data Ready pin for the Azoteq IQS5xx trackpad"
  
  reset-gpios:
    type: phandle-array
    description: "Reset pin for the Azoteq IQS5xx trackpad"

  one-finger-tap:
    type: boolean
    description: "Register single finger tap gestures and report them as a left click"

  press-and-hold:
    type: boolean
    description: "Register press and hold gestures and report them as a left click until released"
  
  press-and-hold-time:
    type: int
    description: "Time in ms (in addition to the tap time) it takes to register a press and hold gesture"
    default: 250

  tap-distance:
    type: int
    description: |
      Max finger movement (in resolution units) for a touch to still count as a
      tap. Raise it if taps right after moving the cursor are missed. 0 keeps
      the chip's current setting.
    default: 0

  touch-threshold-increase:
    type: int
    description: |
      Added to the module's global touch set multiplier (0x0596). The clear
      multiplier (0x0597) is kept, so an established touch is not dropped more
      easily. Threshold = reference * (1 + multiplier / 128), so each +1 needs
      about 0.8% more signal to start a touch; raise it if a hovering finger
      counts as a touch. 0 keeps the module's setting.
    default: 0

  tap-and-drag:
    type: boolean
    description: |
      Tap, then touch again within 250 ms and keep the finger down: the left
      button stays held until the finger is lifted (drag). A quick second tap
      becomes a double click. Needs one-finger-tap.

  two-finger-tap:
    type: boolean
    description: "Register two finger tap gestures and report them as a right click"
  
  scroll:
    type: boolean
    description: "Register and report scroll gestures, both vertical and horizontal scroll is supported"

  natural-scroll-x:
    type: boolean
    description: "Whether content should track finger movement when scrolling on the x axis."

  natural-scroll-y:
    type: boolean
    description: "Whether content should track finger movement when scrolling on the y axis."

  switch-xy:
    type: boolean
    description: "Flip x and y axes"
  
  flip-x:
    type: boolean
    description: "Invert the direction of the x axis"

  flip-y:
    type: boolean
    description: "Invert the direction of the y axis"

  bottom-beta:
    type: int
    description: |
      Amount of filtering applied at slow speeds.
      0: Most filtering, smoother, but laggier.
      255: Least filtering, least smooth, more responsive.
    default: 5
  
  stationary-threshold:
    type: int
    description: |
      How far a finger must move (in pixels) to not be considered stationary.
    default: 5

  active-report-rate:
    type: int
    description: |
      Active mode report rate in milliseconds. Lower values produce a smoother,
      more responsive cursor (e.g. 7 ~= 143 Hz, 5 = 200 Hz). 0 keeps the chip
      default (10 ms / 100 Hz).
    default: 0

  x-resolution:
    type: int
    description: |
      Trackpad X resolution (max coordinate). Higher values give the chip finer
      internal tracking, producing smoother slow movement (less "staircase")
      at the cost of higher effective sensitivity; compensate the cursor speed
      with an input-processor scaler. 0 keeps the chip default.
    default: 0

  y-resolution:
    type: int
    description: |
      Trackpad Y resolution (max coordinate). See x-resolution. 0 keeps the
      chip default.
    default: 0

  rotation-deg:
    type: int
    description: |
      Rotate cursor movement by this many degrees (any angle). Positive turns
      the motion clockwise on screen; write negative values as <(-45)>.
      Applied after switch-xy / flip-x / flip-y; two-finger scroll is not
      rotated. 0 disables rotation.
    default: 0

  inertia-cursor:
    type: boolean
    description: |
      Enable trackball-like inertia for cursor movement: when the finger is
      lifted the cursor keeps moving at the release velocity and decays with
      friction. Touching the pad again stops it instantly.

  inertia-scroll:
    type: boolean
    description: |
      Enable inertia for scrolling (flick scroll): a two-finger scroll keeps
      coasting after the fingers are lifted, decaying with friction.

  inertia-friction:
    type: int
    description: |
      Fraction of the velocity retained each glide tick, out of 256. Larger =
      longer glide (less friction). 242 ~= 0.945 gives roughly a 0.6 s glide.
    default: 242

  inertia-min-speed:
    type: int
    description: |
      Minimum release speed (in counts per report) required to start a glide.
      Slower lifts stop immediately, preventing drift.
    default: 2

  inertia-tick-ms:
    type: int
    description: |
      Interval in ms between synthetic glide reports while coasting. The glide
      starts at the release speed whatever this value is.
    default: 8

  accel-gain-min:
    type: int
    description: |
      Pointer acceleration: cursor gain in percent at or below accel-speed-low.
      100 with accel-gain-max 100 disables acceleration.
    default: 100

  accel-gain-max:
    type: int
    description: |
      Pointer acceleration: cursor gain in percent at or above accel-speed-high.
      A glide keeps the gain reached at release.
    default: 100

  accel-speed-low:
    type: int
    description: |
      Finger speed (counts per report, before any input-processor scaling) up to
      which accel-gain-min applies. The gain ramps linearly up to accel-speed-high.
    default: 0

  accel-speed-high:
    type: int
    description: |
      Finger speed (counts per report) from which accel-gain-max applies.
    default: 0

  ble-min-report-interval-ms:
    type: int
    description: |
      Minimum interval in ms between emitted cursor reports when ZMK's active
      output is BLE. Reports arriving sooner are summed into the next emission so
      the BLE notification queue cannot fall behind on a noisy link. USB output
      is unaffected. 0 disables coalescing.
    default: 0
```

## dts/bindings/input_processors/zmk,input-processor-scroll-speed.yaml
```yaml
# Copyright (c) 2025 Mariano Uvalle
# SPDX-License-Identifier: MIT

description: |
  Scales scroll (INPUT_REL_WHEEL / INPUT_REL_HWHEEL) events by a runtime
  percentage kept separately for USB and for each BLE profile. Adjust it with
  the zmk,behavior-inertia scroll speed actions; values persist to flash.
  Add `track-remainders;` so slow scrolling is not lost to rounding.

compatible: "zmk,input-processor-scroll-speed"

include: ip_zero_param.yaml
```
