## drivers/behaviors/Kconfig
```kconfig
config ZMK_BEHAVIOR_INERTIA
    bool "Trackpad inertia runtime control behavior"
    default y
    depends on DT_HAS_ZMK_BEHAVIOR_INERTIA_ENABLED
    depends on INPUT_AZOTEQ_IQS5XX
```

## drivers/input/Kconfig
```kconfig
menuconfig INPUT_AZOTEQ_IQS5XX
    bool "Azoteq IQS5xx trackpads"
    default y
    depends on GPIO
    depends on I2C
    depends on INPUT
    depends on DT_HAS_AZOTEQ_IQS5XX_ENABLED
    help
      Enable driver for Azoteq IQS5xx trackpads.

if INPUT_AZOTEQ_IQS5XX

config INPUT_AZOTEQ_IQS5XX_INIT_PRIORITY
    int "Azoteq IQS5xx initialization priority"
    default INPUT_INIT_PRIORITY
    help
      Driver initialization priority for the IQS5xx driver.
      Lower values initialize earlier.

config INPUT_AZOTEQ_IQS5XX_WORKQUEUE_STACK_SIZE
    int "Azoteq IQS5xx dedicated workqueue stack size"
    default 1024
    help
      Stack size (bytes) for the dedicated workqueue thread that services
      trackpad reports. Servicing reports on a dedicated queue keeps them off
      the shared system workqueue, reducing jitter for a smoother cursor.

config INPUT_AZOTEQ_IQS5XX_WORKQUEUE_PRIORITY
    int "Azoteq IQS5xx dedicated workqueue thread priority"
    default -1
    help
      Thread priority for the dedicated trackpad workqueue. Lower numbers are
      higher priority; negative values are cooperative. A higher priority
      delivers trackpad reports with less jitter at the cost of preempting
      lower-priority work.

endif # INPUT_AZOTEQ_IQS5XX
```

## dts/bindings/behaviors/zmk,behavior-inertia.yaml
```yaml
# Copyright (c) 2024 The ZMK Contributors
# SPDX-License-Identifier: MIT

description: Trackpad inertia (glide) runtime control behavior

compatible: "zmk,behavior-inertia"

include: one_param.yaml
```
